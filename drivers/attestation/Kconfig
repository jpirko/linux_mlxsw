## drivers/attestation/Kconfig
```kconfig
# SPDX-License-Identifier: GPL-2.0-only
menuconfig ATTESTATION
	tristate "Attestation"
	select CRYPTO_HASH_INFO
	select CTLV
	help
	  Provides a CTLV family for evidence and measurement registers.

	  Providers register one instance for a physical or logical device and
	  translate the common operations to their native service.

	  If you are unsure, say N.
```

## drivers/ctlv/Kconfig
```kconfig
# SPDX-License-Identifier: GPL-2.0-only
config CTLV_TEST
	tristate "CTLV test device"
	select CTLV
	select DEBUG_FS
	help
	  A CTLV family with no hardware behind it, implementing ctlv-test so
	  that the kselftests in tools/testing/selftests/ctlv/ can drive CTLV
	  from userspace.
	  Every op it answers exists because a test needs that exact shape, so
	  some of them behave badly on purpose.

	  Its debugfs directory controls which devices exist and arranges an
	  op's test conditions.

	  If you are unsure, say N.

config CTLV_TEST_MISC
	tristate "CTLV test device on a file of another subsystem"
	depends on CTLV_TEST
	help
	  A ctlv-test device on a misc device, /dev/ctlv-test-misc, whose read
	  answers for the misc device itself. The selftests drive it as a
	  subsystem's own file that also takes CTLV ioctls, with events on a
	  file of their own.

	  If you are unsure, say N.
```

## drivers/virt/coco/tdx-guest/Kconfig
```kconfig
config TDX_GUEST_DRIVER
	tristate "TDX Guest driver"
	depends on INTEL_TDX_GUEST
	depends on ATTESTATION || !ATTESTATION
	select TSM_REPORTS
	select TSM_MEASUREMENTS
	help
	  The driver provides userspace interface to communicate with
	  the TDX module to request the TDX guest details like attestation
	  report. With ATTESTATION, it also registers a TDX attestation
	  device.

	  To compile this driver as module, choose M here. The module will
	  be called tdx-guest.
```

## lib/ctlv/Kconfig
```kconfig
# SPDX-License-Identifier: GPL-2.0-only
config CTLV
	tristate
	# A blob field may name a dma-buf, whatever family declares one.
	select DMA_SHARED_BUFFER

config CTLV_DEBUG
	bool "CTLV core self-checks"
	depends on CTLV
	help
	  Checks the CTLV core's own bookkeeping where no error path depends
	  on the result, and warns once when it is wrong. The checks that do
	  guard an error path are made either way.

	  If you are unsure, say N.

config CTLV_KUNIT_TEST
	tristate "CTLV metadata KUnit tests" if !KUNIT_ALL_TESTS
	depends on CTLV && KUNIT
	default KUNIT_ALL_TESTS
	help
	  Checks the generated schema metadata of every family in this tree
	  against the rules the core relies on without re-checking them at
	  runtime: node indices that stay inside their array, children that are
	  contiguous with the required ones first, IDs composed of the declared
	  parts, and message lengths that agree with the TLV arithmetic. The
	  schema tool's own fixture families are built in for this, so that
	  every shape the schema language allows is covered.

	  The tests are a module of their own, ctlv-kunit, and run when it is
	  loaded, or during boot when it is built in.

	  If you are unsure, say N.
```
